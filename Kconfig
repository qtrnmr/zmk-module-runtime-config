## dts/bindings/behaviors/zmk,behavior-runtime-macro.yaml
```yaml
description: Runtime-editable macro behavior
compatible: "zmk,behavior-runtime-macro"
include: one_param.yaml
```

## dts/bindings/zmk,runtime-conditional-layers.yaml
```yaml
# Copyright (c) 2021 The ZMK Contributors
# SPDX-License-Identifier: MIT

description: Runtime-editable conditional layers (verbatim fork of zmk,conditional-layers)

compatible: "zmk,runtime-conditional-layers"

child-binding:
  description: "Single conditional layer that activates then-layer when if-layers are active"

  properties:
    if-layers:
      type: array
      required: true
    then-layer:
      type: int
      required: true
```
